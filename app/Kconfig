## app/Kconfig
```kconfig
menuconfig LED_SUBSYSTEM
	bool "LED subsystem"
	default y
	depends on GPIO
	help
	  Enable options at build time for adjusting LED behavior in the given
	  application.

if LED_SUBSYSTEM

# LED_BLINK_SLEEP_TIME
config LED_BLINK_SLEEP_TIME_MS
	int
	default 250 if LED_BLINK_SLEEP_FAST_0P25_SEC
	default 500 if LED_BLINK_SLEEP_FAST_0P5_SEC
	default 1000 if LED_BLINK_SLEEP_MEDIUM_1_SEC
	default 2000 if LED_BLINK_SLEEP_SLOW_2_SEC
	default 0

choice
	prompt "LED blink sleep time"
	default LED_BLINK_SLEEP_SLOW_2_SEC
	help
	  Specify the period of LED on and LED off in blinky demonstration.

config LED_BLINK_SLEEP_FAST_0P25_SEC
	bool "0.25 seconds"

config LED_BLINK_SLEEP_FAST_0P5_SEC
	bool "0.5 seconds"

config LED_BLINK_SLEEP_MEDIUM_1_SEC
	bool "1 seconds"

config LED_BLINK_SLEEP_SLOW_2_SEC
	bool "2 seconds"

endchoice

menuconfig LED_SUBSYSTEM_ADVANCED_SETTINGS
	bool "LED subsystem advanced settings"
	default n
	help
	  Enable and configure certain more advanced and detailed LED behavior
	  options.

if LED_SUBSYSTEM_ADVANCED_SETTINGS

config LED_BRIGHTNESS
	int "LED brightness"
	range 0 100
	default 100
	help
	  Set LED brightness (Note symbol available but application code not
	  complete.  Will require hardware PWM or a more CPU intensive
	  software implemenation.)

config LED_FADE_DURATION
	int "LED fade duration in milliseconds"
	range 0 65535
	default 500
	help
	  Select a period in milliseconds during which LED will fade from its
	  set brightness to full off.  (Note this option does not say whether
	  LED fades once and stays off, or fades and then turns on again to
	  repeat this display pattern.)

endif # LED_SUBSYSTEM_ADVANCED_SETTINGS

endif # LED_SUBSYSTEM

# Following Kconfig inclusion needed to support Zephyr logging template macros
source "Kconfig.zephyr"
```
